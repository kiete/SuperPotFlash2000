/////////////////////////////////////////////////////////////////////////////////////////    ECRAN
#include <math.h>

// Code LCD Pour le logo polytech au démarrage
const unsigned char popo [] = {
0x00, 0x00, 0x00, 0x00, 0x00, 0x30, 0x28, 0x48, 0xC8, 0x00, 0xF0, 0x00, 0x00, 0xF0, 0x00, 0xF0,
0x10, 0x10, 0xF0, 0x00, 0xE0, 0x50, 0x50, 0x60, 0x00, 0xF0, 0x10, 0x10, 0x30, 0x00, 0x00, 0x00,
0x00, 0x00, 0x00, 0x00, 0x00, 0x00, 0x00, 0x00, 0x00, 0x00, 0x00, 0x00, 0x00, 0x00, 0x80, 0xC0,
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0x00, 0x00, 0x00, 0x00, 0x00, 0x00, 0x00, 0x00, 
};

/////////////////////////////////////////////////////////////////////////////////////////    /ECRAN

// Pin Assignment

// PIN DE LA PHOTODIODE //
int photoPin = A2;

// PIN DES LED //
int sensorPin = A3;    // select the input pin for the potentiometer
int ledPin = 13;      // select the pin for the LED
int sensorValue = 0;  // variable to store the value coming from the sensor
char valeuraff[4];


// PIN DU MOTEUR //
#define moteur 2
bool indic = false;

// PIN DU THERMOMETRE //
int thermoPin = A1;    // select the input pin for the potentiometer
int thermoValue = 0;  // variable to store the value coming from the sensor
int thMap;

// PIN DE LA TERRE //
int terrePin = A4;
int terreValue;
float terreMap;

// PIN DE L'HUMIDITE //
int HUMPIN = A0;
long vHum;
float humValue;

// VALEUR POUR LE ROULEMENT DES INFOS SUR L'ECRAN
int roulement = 0;


////////////////////////////////////////////////////////////////////////////////////
// Fonction de calcul de l'humidité
////////////////////////////////////////////////////////////////////////////////////
// Temperature <- Temperature de la piece en Celsuis
// Tension <- Tension du dipole d'humidité
////////////////////////////////////////////////////////////////////////////////////
float humidite(float temperature, float tension)
{
  float tab[4][2] = {{-0.0148, -1.3714},
                     {0.13, 10.848},
                     {-0.2853, -34.512},
                     {-0.2807, 105.66}};

  float coeff[4];
  float somme = 0;
  for (int i = 0; i < 4; i++)
  {
    somme = somme + (tab[i][0] * temperature + tab[i][1]) * pow(tension, 3 - i);
  }

  return somme;
}

////////////////////////////////////////////////////////////////////////////////////
// Fonction de choix si arrosage
////////////////////////////////////////////////////////////////////////////////////
// TerreMap <- Valeur de conductivité de la terre mappé
// Arrose quand humitité < 15
// Attends aue Humidité < 30 pour arreter
void arrose (float terreMap){
  if (terreMap <= 30 && indic)
  {
    digitalWrite(moteur, HIGH);
  }

  if (terreMap > 30)
  {
    digitalWrite(moteur, LOW);
    indic = false;
  }

  if (terreMap < 15)
  {
    indic = true;
  }
}

void setup() {
  //initialisation de l'écran
  LCDInit();
  LCDClear();
  LCDBitmap(popo);
  pinMode(HUMPIN , INPUT);
  //déclaration de ledPin comme une sortie
  pinMode(ledPin, OUTPUT);

  pinMode(moteur,OUTPUT);

  pinMode(photoPin , INPUT);
  
  Serial.begin(9600);
  delay(4000);
}


void loop() {

  // Decision de l'arrosage :
  terreValue = analogRead(terrePin);
  terreMap = (1023 - terreValue) / 10.23;
  arrose(terreMap);

  //Photodiode :
  lightValue = analogRead(photoPin);
  lightValue = map(lightValue, 0,500,0,100);

  
  // Thermometre :
  thermoValue = analogRead(thermoPin);
  thMap = map(thermoValue, 0,1023,-20,80);

  // Humidite :
  humValue = analogRead(HUMPIN);
  vHum = map (humValue, 0, 1023 , 0 , 5);
  vHum = humidite(thMap,vHum);

  // AFFICHAGE
  LCDClear();
  //TEMP
  switch (roulement){
    case 0 :
      afficher_soleil(lightValue);
      roulement++;
      break;
    case 1 :
      afficher_hum(vHum);
      roulement++;
      break;
    case 2 :
      afficher_temp(thMap);
      roulement=0;
      break;
  }
  delay(2000);
  
}
